## bluetooth-receiver/sdkconfig.defaults
```kconfig
CONFIG_FREERTOS_HZ=1000
CONFIG_AUTOSTART_ARDUINO=y
CONFIG_COMPILER_DISABLE_DEFAULT_ERRORS=y

CONFIG_ESPTOOLPY_FLASHSIZE_4MB=y
CONFIG_PARTITION_TABLE_CUSTOM=y
CONFIG_PARTITION_TABLE_CUSTOM_FILENAME="partitions.csv"

CONFIG_BT_ENABLED=y
CONFIG_BTDM_CTRL_MODE_BLE_ONLY=n
CONFIG_BTDM_CTRL_MODE_BR_EDR_ONLY=y
CONFIG_BTDM_CTRL_MODE_BTDM=n
CONFIG_BT_BLUEDROID_ENABLED=y
CONFIG_BT_CLASSIC_ENABLED=y
CONFIG_BT_A2DP_ENABLE=y
CONFIG_BT_A2DP_USE_EXTERNAL_CODEC=y
CONFIG_BT_A2DP_CODEC_AAC_ENABLED=y
CONFIG_BT_A2DP_SEP_NUM_MAX=2
CONFIG_BT_SPP_ENABLED=y
CONFIG_BT_BLE_ENABLED=n
```

## temperature-monitor/sdkconfig.defaults
```kconfig
CONFIG_FREERTOS_HZ=1000
CONFIG_AUTOSTART_ARDUINO=y

CONFIG_ESPTOOLPY_FLASHSIZE_4MB=y-
CONFIG_PARTITION_TABLE_CUSTOM=y
CONFIG_PARTITION_TABLE_CUSTOM_FILENAME="partitions.csv"

CONFIG_BT_ENABLED=y
CONFIG_BT_BLUEDROID_ENABLED=y
CONFIG_BT_CLASSIC_ENABLED=y
CONFIG_BT_SPP_ENABLED=y
CONFIG_BT_SSP_ENABLED=y

CONFIG_TFT_eSPI_ESPIDF=y
CONFIG_TFT_ILI9341_DRIVER=y
CONFIG_TFT_SPI=y
CONFIG_TFT_VSPI_PORT=y

CONFIG_TFT_CS=27
CONFIG_TFT_DC=26
CONFIG_TFT_RST=25
CONFIG_TFT_MISO=35
CONFIG_TFT_MOSI=14
CONFIG_TFT_SCLK=32
CONFIG_TFT_BL=33

CONFIG_ENABLE_BL=y
CONFIG_TFT_BACKLIGHT_ON_HIGH=y

CONFIG_TFT_RGB_ORDER=n
CONFIG_TFT_BGR_ORDER=y

CONFIG_TFT_SPI_FREQUENCY=40000000
CONFIG_TFT_SPI_READ_FREQ=20000000

CONFIG_LV_FONT_MONTSERRAT_14=y
CONFIG_LV_FONT_MONTSERRAT_32=y
CONFIG_LV_FONT_MONTSERRAT_44=y
CONFIG_LV_FONT_MONTSERRAT_46=y
CONFIG_LV_FONT_MONTSERRAT_48=y
```
